## build/conf/bblayers.conf
```bitbake
# POKY_BBLAYERS_CONF_VERSION is increased each time build/conf/bblayers.conf
# changes incompatibly
POKY_BBLAYERS_CONF_VERSION = "2"

BBPATH = "${TOPDIR}"
BBFILES ?= ""

BBLAYERS ?= " \
  ${TOPDIR}/../meta-openembedded/meta-oe \
  ${TOPDIR}/../meta-openembedded/meta-python \
  ${TOPDIR}/../meta-openembedded/meta-networking \
  ${TOPDIR}/../meta-openembedded/meta-filesystems \
  ${TOPDIR}/../meta-rockchip \
  ${TOPDIR}/../meta-asus \
  ${TOPDIR}/../poky/meta \
  ${TOPDIR}/../poky/meta-poky \
  ${TOPDIR}/../poky/meta-yocto-bsp \
  ${TOPDIR}/../meta-virtualization \
  ${TOPDIR}/../meta-intel-realsense \
  ${TOPDIR}/../meta-python2 \
  ${TOPDIR}/../meta-fuji \
"
#  ${TOPDIR}/../meta-qt5 
#  ${TOPDIR}/../meta-clang 
#  ${TOPDIR}/../meta-virtualization
```

## meta-fuji/conf/layer.conf
```bitbake
# We have a conf and classes directory, add to BBPATH
BBPATH .= ":${LAYERDIR}"

# We have recipes-* directories, add to BBFILES
BBFILES += "${LAYERDIR}/recipes-*/*/*.bb \
            ${LAYERDIR}/recipes-*/*/*.bbappend"

BBFILE_COLLECTIONS += "meta-fuji"
BBFILE_PATTERN_meta-fuji = "^${LAYERDIR}/"
BBFILE_PRIORITY_meta-fuji = "6"

LAYERDEPENDS_meta-fuji = "core"
LAYERSERIES_COMPAT_meta-fuji = "kirkstone"
```
